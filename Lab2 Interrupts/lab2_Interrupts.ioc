# file: lab2_Interrupts.ioc
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Mcu.Family=STM32F0
Mcu.Name=STM32F072R(8-B)Tx
Mcu.Package=LQFP64
ProjectManager.HeapSize=0x200
ProjectManager.StackSize=0x400
ProjectManager.TargetToolchain=MDK-ARM V5.32
board=custom

// file: Core/Src/main.c
/* USER CODE BEGIN Header */
/**
  ******************************************************************************
  * @file           : main.c
  * @brief          : Main program body
  ******************************************************************************
  * @attention
  *
  * Copyright (c) 2024 STMicroelectronics.
  * All rights reserved.
  *
  * This software is licensed under terms that can be found in the LICENSE file
  * in the root directory of this software component.
  * If no LICENSE file comes with this software, it is provided AS-IS.
  *
  ******************************************************************************
  */
/* USER CODE END Header */
#include "main.h"

void SystemClock_Config(void);

int main(void)
{

  /* MCU Configuration--------------------------------------------------------*/

  /* Reset of all peripherals, Initializes the Flash interface and the Systick. */
  HAL_Init();

  /* Configure the system clock */
  SystemClock_Config();

  /* Initialize all configured peripherals */
  /* USER CODE BEGIN 2 */
		// ENABLING RCC Peripheral Clocks
		RCC->AHBENR |= RCC_AHBENR_GPIOCEN;		// Enabling GPIOC Clock
		RCC->AHBENR |= RCC_AHBENR_GPIOAEN;
		RCC->APB2ENR |= RCC_APB2ENR_SYSCFGCOMPEN;
		//__HAL_RCC_GPIOC_CLK_ENABLE();
		GPIOC->MODER |= ((1<<12) | (1<<18) | (1<<14) | (1<<16));
		GPIOC->OTYPER = 0;
		GPIOC->OSPEEDR = 0;
		GPIOC->PUPDR = 0;
		GPIOC->ODR |= (1<<9);
		GPIOC->ODR &= ~ (1<<6);
		GPIOC->ODR &= ~ (1<<7);
		GPIOC->ODR &= ~ (1<<8);
		GPIOA->MODER = 0;
		GPIOA->OSPEEDR =0;
		GPIOA->PUPDR |= (1 << 1);
		EXTI->IMR |= 1;
		EXTI->RTSR |= 1;
		SYSCFG->EXTICR[0] |= SYSCFG_EXTICR1_EXTI0_PA;
		NVIC_EnableIRQ(5);
		NVIC_SetPriority(EXTI0_1_IRQn,1);
		//NVIC_SetPriority(SysTick_IRQn,2);
  /* USER CODE END 2 */

  /* Infinite loop */
  while (1)
  {
			GPIOC->ODR &= ~(1<<6);
			HAL_Delay(200);
			GPIOC->ODR |= (1<<6);
			HAL_Delay(200);
  }
}

void SystemClock_Config(void)
{
  RCC_OscInitTypeDef RCC_OscInitStruct = {0};
  RCC_ClkInitTypeDef RCC_ClkInitStruct = {0};

  /** Initializes the RCC Oscillators according to the specified parameters
  * in the RCC_OscInitTypeDef structure.
  */
  RCC_OscInitStruct.OscillatorType = RCC_OSCILLATORTYPE_HSI;
  RCC_OscInitStruct.HSIState = RCC_HSI_ON;
  RCC_OscInitStruct.HSICalibrationValue = RCC_HSICALIBRATION_DEFAULT;
  RCC_OscInitStruct.PLL.PLLState = RCC_PLL_NONE;
  if (HAL_RCC_OscConfig(&RCC_OscInitStruct) != HAL_OK)
  {
    Error_Handler();
  }

  /** Initializes the CPU, AHB and APB buses clocks
  */
  RCC_ClkInitStruct.ClockType = RCC_CLOCKTYPE_HCLK|RCC_CLOCKTYPE_SYSCLK
                              |RCC_CLOCKTYPE_PCLK1;
  RCC_ClkInitStruct.SYSCLKSource = RCC_SYSCLKSOURCE_HSI;
  RCC_ClkInitStruct.AHBCLKDivider = RCC_SYSCLK_DIV1;
  RCC_ClkInitStruct.APB1CLKDivider = RCC_HCLK_DIV1;

  if (HAL_RCC_ClockConfig(&RCC_ClkInitStruct, FLASH_LATENCY_0) != HAL_OK)
  {
    Error_Handler();
  }
}
void EXTI0_1_IRQHandler(void)
{
//		//HAL_GPIO_TogglePin(GPIOC, GPIO_PIN_8 | GPIO_PIN_9);
//		GPIOC->ODR ^= (1<<8);
//		GPIOC->ODR ^= (1<<9);
//		for (volatile int counter_delay =0 ; counter_delay < 1500000 ; counter_delay++){}
		HAL_GPIO_TogglePin(GPIOC, GPIO_PIN_8 | GPIO_PIN_9);
//		GPIOC->ODR ^= (1<<8);
//		GPIOC->ODR ^= (1<<9);
		EXTI->PR |= (1<<0);
}

void Error_Handler(void)
{
  __disable_irq();
  while (1)
  {
  }
}
